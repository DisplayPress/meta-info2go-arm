## conf/layer.conf
```bitbake
# We have a conf and classes directory, add to BBPATH
BBPATH .= ":${LAYERDIR}"

# We have a packages directory, add to BBFILES
BBFILES += "${LAYERDIR}/recipes-*/*/*.bb \
            ${LAYERDIR}/recipes-*/*/*.bbappend"

BBFILE_COLLECTIONS += "info2go-arm"
BBFILE_PATTERN_info2go-arm := "^${LAYERDIR}/"
BBFILE_PRIORITY_info2go-arm = "1"

LAYERDEPENDS_fsl-arm-extra = "core fsl-arm"
```

## conf/machine/amherst-quad.conf
```bitbake
#@TYPE: Machine
#@NAME: Info2Go i.MX6Q Amherst Device
#@SOC: i.MX6Q
#@DESCRIPTION: Machine configuration for Info2Go i.MX6Q Amherst Device
#@MAINTAINER: Steve Scheidecker <steve@info2gousa.com>

require include/amherst.inc

SOC_FAMILY = "mx6:mx6q:amherst-quad"

KERNEL_DEVICETREE = "imx6q-amherst.dtb"

UBOOT_CONFIG ??= "sd"
UBOOT_CONFIG[sd] = "amherst-quad_config,sdcard"
UBOOT_CONFIG[mfgtool] = "amherst-quad_config"
```

## conf/machine/include/amherst.inc
```bitbake
#Common settings for Info2Go amherst boards

include conf/machine/include/imx-base.inc
include conf/machine/include/tune-cortexa9.inc

PREFERRED_PROVIDER_virtual/kernel ?= "linux-amherst"
PREFERRED_VERSION_linux-amherst ?= "3.14.28"

SERIAL_CONSOLE = "115200 ttymxc0"

MACHINE_FEATURES += "pci wifi bluetooth touchscreen"

KERNEL_IMAGETYPE = "zImage"
```
